
/include/ "mailbox.dtsi"

&ddr4_ddr4_0 {
    compatible = "generic-uio";
};

&iic_axi_iic_ds28c36 {
  compatible = "xlnx,axi-iic-2.0", "xlnx,xps-iic-2.00.a";
  clock-names = "s_axi_aclk";
  clocks = <&zynqmp_clk 71>;
};

&iic_axi_iic_fplink {
  compatible = "xlnx,axi-iic-2.0", "xlnx,xps-iic-2.00.a";
  clock-names = "s_axi_aclk";
  clocks = <&zynqmp_clk 71>;
};

&iic_axi_iic_wr {
  compatible = "xlnx,axi-iic-2.0", "xlnx,xps-iic-2.00.a";
  clock-names = "s_axi_aclk";
  clocks = <&zynqmp_clk 71>;
};


