## conf/layer.conf
```bitbake
# We have a conf and classes directory, add to BBPATH
BBPATH .= ":${LAYERDIR}"

# We have recipes-* directories, add to BBFILES
BBFILES += "${LAYERDIR}/recipes-*/*/*.bb \
            ${LAYERDIR}/recipes-*/*/*.bbappend \
            ${LAYERDIR}/packagegroups/*.bb \
           "

BBFILE_COLLECTIONS += "meta-techlab-bsp"
BBFILE_PATTERN_meta-techlab-bsp = "^${LAYERDIR}/"
BBFILE_PRIORITY_meta-techlab-bsp = "9"
LAYERDEPENDS_meta-techlab-bsp = "core meta-techlab-utils"
LAYERVERSION_meta-techlab-bsp = "1"
LAYERSERIES_COMPAT_meta-techlab-bsp = "zeus gatesgarth"
```

## conf/machine/damc-fmc1z7io.conf
```bitbake
#@TYPE: Machine
#@NAME: DAMC-FMC1Z7IO
#@DESCRIPTION: Machine support for DAMC-FMC1Z7IO

SOC_VARIANT ?= "7z"

require conf/machine/include/soc-zynq.inc
require conf/machine/include/machine-xilinx-default.inc

Z7IO_BOARD_REV ?= 'rev-b'
MACHINEOVERRIDES .= ":damc-fmc1z7io:damc-fmc1z7io-${Z7IO_BOARD_REV}"

MACHINE_FEATURES = "ext2 vfat usbhost"

# u-boot configuration
PREFERRED_PROVIDER_virtual/bootloader = "u-boot-xlnx"
UBOOT_MACHINE = "xilinx_zynq_virt_defconfig"
SPL_BINARY = "spl/boot.bin"

PREFERRED_PROVIDER_virtual/kernel = "linux-xlnx"

EXTRA_IMAGEDEPENDS += " \
               u-boot-zynq-uenv \
               virtual/boot-bin \
               virtual/bitstream \
               virtual/bootloader \
               u-boot-zynq-scr \
               fsbl \
               "

SERIAL_CONSOLE = "115200 ttyPS0"

IMAGE_BOOT_FILES += " \
               boot.bin \
               uImage \
               damc-fmc1z7io-system.dtb \
               ${@'' if d.getVar('FPGA_MNGR_RECONFIG_ENABLE') == '1' else 'download-damc-fmc1z7io.bit'} \
               "
```

## conf/machine/damc-fmc2zup.conf
```bitbake
#@TYPE: Machine
#@NAME: damc-fmc2zup
#@DESCRIPTION: Machine support for DAMC-FMC2ZUP

SOC_VARIANT ?= "eg"

require conf/machine/include/tune-zynqmp.inc
require conf/machine/include/machine-xilinx-overrides.inc
require conf/machine/include/machine-xilinx-default.inc
require conf/machine/include/machine-xilinx-board.inc

MACHINE_FEATURES = "ext2 vfat usbhost"

# u-boot configuration
PREFERRED_PROVIDER_virtual/bootloader = "u-boot-xlnx"
UBOOT_MACHINE = "xilinx_zynqmp_zcu102_rev1_0_defconfig"
SPL_BINARY = "spl/boot.bin"

EXTRA_IMAGEDEPENDS += " \
               u-boot-zynq-uenv \
               virtual/boot-bin \
               fsbl \
               "

SERIAL_CONSOLE = "115200 ttyPS0"

IMAGE_BOOT_FILES += " \
               boot.bin \
               fsbl \
               "
```

## conf/machine/damc-motctrl.conf
```bitbake
#@TYPE: Machine
#@NAME: damc-motctrl
#@DESCRIPTION: Machine support for DAMC-MOTCTRL

SOC_VARIANT ?= "eg"

require conf/machine/include/soc-zynqmp.inc
require conf/machine/include/machine-xilinx-default.inc
require conf/machine/include/machine-xilinx-qemu.inc

MACHINE_FEATURES = "ext2 vfat usbhost"

# u-boot configuration
PREFERRED_PROVIDER_virtual/bootloader = "u-boot-xlnx"
UBOOT_MACHINE = "xilinx_zynqmp_virt_defconfig"
SPL_BINARY = "spl/boot.bin"

EXTRA_IMAGEDEPENDS += " \
               u-boot-zynq-uenv \
               virtual/boot-bin \
               virtual/bootloader \
               fsbl \
               "

SERIAL_CONSOLE = "115200 ttyPS0"

IMAGE_BOOT_FILES += " \
               boot.bin \
               Image \
               damc-motctrl-system.dtb \
               ${@'' if d.getVar('FPGA_MNGR_RECONFIG_ENABLE') == '1' else 'damc-motctrl-top.bit'} \
               "

TECHLAB_BOARD_DIR = "/opt/mtca-tech-lab/damc-motctrl"
```
